## components/esp_cam_sensor_imx/Kconfig
```kconfig
menu "Camera Sensor (IMX add-on)"

    config CAMERA_IMX219
        bool "Support IMX219 (Raspberry Pi Camera Module v2)"
        default n
        help
            Enable the Sony IMX219 MIPI-CSI driver.

            Verified on hardware as of 0.2.0: streaming, auto-exposure through
            esp_video's 3A loop, stills and H.264 video.

            Still off by default only because a build should not carry two
            sensors' register tables when it uses one. Turn it on for an IMX219
            and turn CAMERA_IMX708 off.

    if CAMERA_IMX219

        config CAMERA_IMX219_AUTO_DETECT_MIPI_INTERFACE_SENSOR
            bool "Auto-detect IMX219 on the MIPI-CSI interface"
            default y
            help
                Register the IMX219 in the esp_cam_sensor auto-detect list so
                esp_video probes for it automatically at start-up.

        config CAMERA_IMX219_MIPI_IF_FORMAT_INDEX_DEFAULT
            int "Default MIPI-CSI mode index"
            default 0
            range 0 2
            help
                Which entry of the driver's mode table the sensor comes up in.

                  0 - 1640x1232 RAW10 30fps, 2x2 binned, full field of view.
                      The general-purpose default.
                  1 - 3280x2464 RAW10 15fps, full resolution. Note this is
                      wider than the ESP32-P4's ~1920 px datapath limit and
                      will produce duplicated columns; it is not usable yet.
                  2 - 1632x1232 RAW10 30fps. Mode 0 with 8 columns trimmed so
                      the width is a whole number of 16-pixel H.264
                      macroblocks. Choose this for video: the P4's ISP crop
                      only exists on chip revision v3.0 and later, and the
                      H.264 core derives its line stride from the width it is
                      given, so a non-multiple-of-16 width shears the picture.
                      Costs 0.5% of the horizontal field of view.

    endif # CAMERA_IMX219

    config CAMERA_IMX708
        bool "Support IMX708 (Raspberry Pi Camera Module 3 / NoIR 3)"
        default y
        help
            Enable the Sony IMX708 MIPI-CSI driver. The default mode is a 2x2
            binned 1920x1080 RAW10 stream. Autofocus lives in a separate driver
            (the DW9807 VCM below) because it is a separate chip; PDAF is not
            driven.

    if CAMERA_IMX708

        config CAMERA_IMX708_AUTO_DETECT_MIPI_INTERFACE_SENSOR
            bool "Auto-detect IMX708 on the MIPI-CSI interface"
            default y
            help
                Register the IMX708 in the esp_cam_sensor auto-detect list so
                esp_video probes for it automatically at start-up.

        config CAMERA_IMX708_MIPI_IF_FORMAT_INDEX_DEFAULT
            int "Default MIPI-CSI mode index"
            default 0
            range 0 4
            help
                Which entry of the driver's mode table the sensor comes up in.

                All five are the same 2x2-binned RAW10 readout at 28 fps and
                differ only in how much of it is digitally cropped away, so a
                smaller mode buys CSI bandwidth, PSRAM and encode time, and
                pays in field of view. It does not make the sensor faster -
                every mode reads out at 28 fps - but it does recover frames the
                pipeline drops at full size: imx708_video measures 27.3 fps at
                1920x1080 and 28.0 at every smaller mode. Exposure range does
                not change. Nothing is scaled: a smaller mode is a narrower window on
                the middle of the scene, not the whole scene shrunk.

                  0 - 1920x1080, 83% of the field each way. The general-purpose
                      default and the mode the examples were measured at.
                  1 - 1280x720, 56% of the field each way, 44% of the pixels.
                      Both axes are whole 16-pixel H.264 macroblocks, so unlike
                      1080 this needs no height trim before the encoder.
                  2 - 1024x768, 44% of the field across and 59% up and down,
                      38% of the pixels. 4:3, so it sees less than mode 1
                      horizontally and more vertically. The only mode whose
                      width and height are both whole 16-pixel macroblocks
                      (64x48) - even 1080 is not - so nothing has to be
                      trimmed before the encoder.
                  3 - 800x600, 35% of the field across and 46% up and down,
                      23% of the pixels. SVGA, the middle 4:3 step. 800 is 50
                      whole macroblocks but 600 is 37.5, so like 1080 - and
                      unlike every other mode here - it needs the encoder's
                      height trim.
                  4 - 640x480, 15% of the pixels. A tight window - 28% of the
                      field horizontally and 37% vertically - and 4:3 out of a
                      16:9 field, so it frames the scene differently rather
                      than showing less of it evenly.

                Modes are ordered largest to smallest.

                An application can override this at run time: pass a mode from
                imx708_format_by_index() or imx708_format_by_size() to
                esp_video's VIDIOC_S_SENSOR_FMT before allocating buffers.

        choice CAMERA_IMX708_LINK_FREQ
            prompt "MIPI link frequency"
            default CAMERA_IMX708_LINK_FREQ_450MHZ
            help
                The MIPI D-PHY clock the sensor transmits at. Data is sent on
                both clock edges, so each of the two lanes carries twice this
                in bits per second.

                The three are Raspberry Pi's, and they exist for one reason:
                to move the link's harmonics off a radio channel they would
                otherwise land on. The ESP32-C6 on the same board transmits
                centimetres from the camera cable, so if WiFi throughput drops
                while the camera streams - or frames tear only while WiFi is
                busy - try the other two.

                Only the link moves. The pixel clock is a separate PLL, so
                frame rate, exposure and every mode are identical at all
                three. All three also carry the widest mode's line (1920
                RAW10 pixels per 13.36 us, about 1.44 Gbit/s across both
                lanes) with room to spare.

                An application can change it at run time while the sensor is
                not streaming: imx708_set_link_freq() in imx708.h.

            config CAMERA_IMX708_LINK_FREQ_450MHZ
                bool "450 MHz (900 Mbit/s per lane)"
            config CAMERA_IMX708_LINK_FREQ_447MHZ
                bool "447 MHz (894 Mbit/s per lane)"
            config CAMERA_IMX708_LINK_FREQ_453MHZ
                bool "453 MHz (906 Mbit/s per lane)"
        endchoice

    endif # CAMERA_IMX708

endmenu

menu "Camera Motor (IMX add-on)"

    rsource "motors/dw9807/Kconfig.dw9807"

endmenu
```

## components/esp_cam_sensor_imx/examples/imx708_video/main/Kconfig.projbuild
```kconfig
menu "IMX708 video example: board"

    config EXAMPLE_CAM_POWER_EN_GPIO
        int "GPIO that powers the camera module (-1 if none)"
        range -1 54
        default -1
        help
            Some boards route a GPIO to the camera connector's power-enable
            line (CAM_IO0 on the Raspberry Pi pinout), which switches the
            module's own regulators on and releases its reset. Until that GPIO
            is driven high the IMX708 is unpowered: nothing answers on I2C,
            and the I2C driver reports "clear bus failed" because the module's
            pull-ups are dead too.

            -1 for boards that power the connector permanently, such as the
            Waveshare ESP32-P4-WIFI6. 0 on the Wireless-Tag WT9932P4-TINY,
            whose BSP drives IO0 high before touching the camera.

endmenu
```

## components/esp_cam_sensor_imx/motors/dw9807/Kconfig.dw9807
```kconfig
menuconfig CAM_MOTOR_DW9807
    bool "DW9807 VCM (Raspberry Pi Camera Module 3 autofocus)"
    default n
    select CAMERA_MOTOR_DEVICE_USED
    help
        Enable the Dongwoon DW9807 voice-coil-motor driver - the autofocus
        actuator fitted to the Raspberry Pi Camera Module 3 / NoIR 3, at I2C
        0x0c on the same bus as the IMX708.

        Without this the lens never moves: it sits wherever its spring rests it,
        which is past infinity, and every picture is soft no matter how well the
        exposure and colour are tuned.

        Closed-loop autofocus additionally needs ESP_IPA_AF_ALGORITHM,
        ESP_VIDEO_ENABLE_CAMERA_MOTOR_CONTROLLER and
        ESP_VIDEO_ISP_PIPELINE_CONTROL_CAMERA_MOTOR, plus an "af" block in the
        sensor's IPA tuning JSON. With the motor alone you get a lens you can
        position by hand through V4L2_CID_FOCUS_ABSOLUTE, but nothing that
        decides where to put it.

if CAM_MOTOR_DW9807

    config CAM_MOTOR_DW9807_AUTO_DETECT
        bool "Auto-detect the DW9807"
        default y
        help
            Register the DW9807 in the esp_cam_sensor motor auto-detect list so
            esp_video probes for it during esp_video_init(). The application
            still has to pass a cam_motor entry and ESP_VIDEO_INIT_FLAGS_MOTOR
            in its esp_video_init_config_t - auto-detect only decides which
            drivers are candidates, not whether probing happens at all.

    config CAM_MOTOR_DW9807_INIT_POS
        int "Lens park position at start-up (DAC code)"
        range 0 1023
        default 512
        help
            Where the lens is placed as soon as the motor is detected, before
            the autofocus loop has converged - so it governs how the first few
            frames look, and it is the whole answer for a build with no AF
            algorithm.

            The DAC is 10-bit, but only part of that travel is useful. Measured
            on this module with the focus sweep in examples/imx708_snapshot:
            codes below ~384 are a dead plateau with the lens against its stop,
            the rise starts at 448, and a ~2 m subject peaked at 576.

            The default of 512 sits just above the dead zone, so it is sharp for
            distant subjects without wasting the park on travel that does
            nothing. It was 450 - that turned out to be at the very bottom of
            the rise and measurably soft (1467 against 1837 at the peak). Raise
            it towards 700-900 if the camera mostly looks at things within
            arm's reach.

            Re-measure on your own module: VCM assemblies vary unit to unit, and
            the figures above are from one specific Camera Module 3.

    config CAM_MOTOR_DW9807_PERIOD_US
        int "Settling time allowed per DAC code (microseconds)"
        range 1 65535
        default 3000
        help
            Reported to the autofocus algorithm as step_period.period_in_us, and
            used together with the timestamp of the last move to decide when the
            ISP's focus statistics for a new lens position can be believed.

            The DW9807 applies a new code immediately; what takes time is the
            lens settling on its spring, which is closer to a fixed ring-down
            than to something proportional to distance travelled - so this is a
            linear approximation of a non-linear thing. The default gives a
            coarse scan step (tens of codes) about a frame to settle.

            Raised from 1000 to 3000 after the sweep: at 1000 a coarse scan step
            of ~50 codes got only 50 ms, but a frame is 36 ms at 28 fps with two
            buffers in flight, so the real move-to-statistics-reflect-it latency
            is nearer 70-110 ms plus mechanical settle. The sweep allowed five
            frames per position and produced a clean single-peaked curve, so
            that much patience is known to be enough; 3000 gives a coarse step
            about the same budget.

            Raise it further if autofocus lands on a different position each
            time it runs on the same static scene: that is the signature of
            definition being sampled while the lens is still moving.

endif # CAM_MOTOR_DW9807
```

## examples/guition_eth_probe/sdkconfig.defaults
```kconfig
CONFIG_IDF_TARGET="esp32p4"
CONFIG_ESP32P4_SELECTS_REV_LESS_V3=y
CONFIG_ESP32P4_REV_MIN_100=y
CONFIG_ESPTOOLPY_FLASHSIZE_16MB=y
CONFIG_ETH_ENABLED=y
CONFIG_ETH_USE_ESP32_EMAC=y
CONFIG_EXAMPLE_ETH_PHY_INTERFACE_RMII=y
CONFIG_EXAMPLE_ETH_RMII_CLK_INPUT=y
CONFIG_EXAMPLE_ETH_RMII_CLK_GPIO=50
CONFIG_EXAMPLE_ETH_MDC_GPIO=31
CONFIG_EXAMPLE_ETH_MDIO_GPIO=52
CONFIG_EXAMPLE_ETH_PHY_ADDR=-1
CONFIG_EXAMPLE_ETH_PHY_RST_GPIO=51
CONFIG_EXAMPLE_ETH_RMII_TX_EN_GPIO=49
CONFIG_EXAMPLE_ETH_RMII_TXD0_GPIO=34
CONFIG_EXAMPLE_ETH_RMII_TXD1_GPIO=35
CONFIG_EXAMPLE_ETH_RMII_CRS_DV_GPIO=28
CONFIG_EXAMPLE_ETH_RMII_RXD0_GPIO=29
CONFIG_EXAMPLE_ETH_RMII_RXD1_GPIO=30
```
